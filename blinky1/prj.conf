## prj.conf
```kconfig
# Print a banner on the UART on startup.
CONFIG_BOOT_BANNER=y

# Enable console and printk()
CONFIG_PRINTK=y
CONFIG_STDOUT_CONSOLE=y

# Enable Zephyr application to be booted by MCUboot
CONFIG_BOOTLOADER_MCUBOOT=y

# Use the default MCUBoot PEM key file (BOOT_SIGNATURE_KEY_FILE)
CONFIG_MCUBOOT_SIGNATURE_KEY_FILE="bootloader/mcuboot/root-rsa-2048.pem"
#CONFIG_MAIN_STACK_SIZE=8192
#CONFIG_ISR_STACK_SIZE=4096
CONFIG_MAIN_STACK_SIZE=1024
#CONFIG_PRIVILEGED_STACK_SIZE=4096
#CONFIG_ISR_STACK_SIZE=8192
CONFIG_NULL_POINTER_EXCEPTION_DETECTION_NONE=y
#CONFIG_NULL_POINTER_EXCEPTION_DETECTION_MPU=y


CONFIG_DEBUG=y

CONFIG_DEBUG_INFO=y
#CONFIG_UART_CONSOLE=n
#CONFIG_UART_STM32=n
#CONFIG_UART_INTERRUPT_DRIVEN=n
CONFIG_SERIAL=y
CONFIG_ARM_MPU=n
CONFIG_CONSOLE=y
```

## src/main.c
```c
/*
 * Copyright (c) 2017 Linaro, Ltd.
 *
 * SPDX-License-Identifier: Apache-2.0
 */

#include <zephyr/kernel.h>
#include <zephyr/sys/printk.h>
#include <zephyr/drivers/gpio.h>

#define SLEEP_TIME_MS   1000

#define LED0_NODE DT_ALIAS(led0)
static const struct gpio_dt_spec led = GPIO_DT_SPEC_GET(LED0_NODE, gpios);

void main(void)
{
	//printk("Hello World from %s on %s!\n",
	   //    MCUBOOT_HELLO_WORLD_FROM, CONFIG_BOARD);
int ret;
	bool led_state = true;

	if (!gpio_is_ready_dt(&led)) {
		return 0;
	}

	ret = gpio_pin_configure_dt(&led, GPIO_OUTPUT_ACTIVE);
	if (ret < 0) {
		return 0;
	}

	while (1) {
		ret = gpio_pin_toggle_dt(&led);
		if (ret < 0) {
			return 0;
		}

		led_state = !led_state;
		//printf("LED state: %s\n", led_state ? "ON" : "OFF");
		k_msleep(SLEEP_TIME_MS);
	}
	return 0;
}
```
